## afe_s3/sdkconfig.defaults
```kconfig
CONFIG_IDF_TARGET="esp32s3"
CONFIG_ESPTOOLPY_FLASHSIZE_8MB=y
CONFIG_PARTITION_TABLE_CUSTOM=y
CONFIG_PARTITION_TABLE_CUSTOM_FILENAME="partitions.csv"
CONFIG_ESP_DEFAULT_CPU_FREQ_MHZ_240=y
CONFIG_FREERTOS_HZ=1000

# PSRAM octal 8 MB (ESP32-S3-PICO-1-N8R8)
CONFIG_SPIRAM=y
CONFIG_SPIRAM_MODE_OCT=y
CONFIG_SPIRAM_SPEED_80M=y
CONFIG_SPIRAM_ALLOW_STACK_EXTERNAL_MEMORY=y
CONFIG_SPIRAM_TRY_ALLOCATE_WIFI_LWIP=y

# Đo CPU từng core bằng uxTaskGetSystemState
CONFIG_FREERTOS_USE_TRACE_FACILITY=y
CONFIG_FREERTOS_GENERATE_RUN_TIME_STATS=y
CONFIG_FREERTOS_VTASKLIST_INCLUDE_COREID=y

CONFIG_COMPILER_OPTIMIZATION_PERF=y
CONFIG_ESP_CONSOLE_USB_SERIAL_JTAG=y
```

## cp_s3/main/Kconfig.projbuild
```kconfig
menu "StickS3 audio_fe"

    config AUDIO_FE_ENABLE
        bool "Run audio_fe (ES8311 + AFE + I2S link to the P4)"
        default y

    config AUDIO_FE_BYPASS
        bool "Bypass the AFE: send the raw mic to the link (check the I2S wiring before enabling the AFE)"
        depends on AUDIO_FE_ENABLE
        default n

    config AUDIO_FE_AMP_ALWAYS_ON
        bool "Amplifier always on (latency measurements only; avoids pops when it switches)"
        depends on AUDIO_FE_ENABLE
        default n

    config AUDIO_FE_LINK_ECHO
        bool "Link echo: return the P4 playback to the P4 (electrical link latency, not through speaker/mic)"
        depends on AUDIO_FE_ENABLE
        default n

    config AUDIO_FE_FD_HIGH
        bool "AFE_TYPE_FD + HIGH_PERF (otherwise FD LOW_COST)"
        depends on AUDIO_FE_ENABLE && !AUDIO_FE_BYPASS
        default y

endmenu
```

## phone_s3/components/esp32p4c5_bsp/Kconfig
```kconfig
menu "Board Support Package (KSDIY ESP32-P4/C5)"

    config BSP_ERROR_CHECK
        bool "Enable error check in BSP"
        default y
        help
            Error check assert the application before returning the error code.

    config BSP_AUDIO_S3_LINK
        bool "Audio through the ESP32-S3 co-processor (I2S link on JP1)"
        default y
        help
            Microphone and speaker are the S3's (ES8311 + AFE with echo cancellation); the on-board ES8311 and ES7210
            are not used. The apps keep using bsp_audio_codec_speaker_init() / bsp_audio_codec_microphone_init().

    menu "I2C"
        config BSP_I2C_NUM
            int "I2C peripheral index"
            default 0
            range 0 1
            help
                ESP32-P4 has two I2C peripherals, pick the one you want to use.
                Touch, PMIC, audio codecs, IMU and camera SCCB all sit on this bus.

        config BSP_I2C_FAST_MODE
            bool "Enable I2C fast mode"
            default y
            help
                I2C has two speed modes: normal (100kHz) and fast (400kHz).

        config BSP_I2C_CLK_SPEED_HZ
            int
            default 400000 if BSP_I2C_FAST_MODE
            default 100000
    endmenu

    menu "PMIC (AXP2101)"
        config BSP_PMIC_SET_CHARGER
            bool "Program the battery charger in bsp_battery_init()"
            default n
            help
                Off: keep the charge current and voltage already in the AXP2101 (its defaults,
                or what an earlier program wrote). On: write the values below. Pick them from
                the battery datasheet; a charge current above the battery rating is unsafe.

        config BSP_PMIC_CHARGE_CURRENT_MA
            int "Constant charge current (mA)"
            depends on BSP_PMIC_SET_CHARGER
            range 200 1000
            default 500
            help
                Rounded down to the charger step (100 mA from 200 mA up).

        choice BSP_PMIC_CHARGE_VOLTAGE
            prompt "Charge target voltage"
            depends on BSP_PMIC_SET_CHARGER
            default BSP_PMIC_CHARGE_VOLTAGE_4V20
            config BSP_PMIC_CHARGE_VOLTAGE_4V10
                bool "4.10 V"
            config BSP_PMIC_CHARGE_VOLTAGE_4V20
                bool "4.20 V (standard Li-ion / LiPo)"
            config BSP_PMIC_CHARGE_VOLTAGE_4V35
                bool "4.35 V (high voltage LiPo)"
            config BSP_PMIC_CHARGE_VOLTAGE_4V40
                bool "4.40 V (high voltage LiPo)"
        endchoice

        config BSP_PMIC_CHARGE_VOLTAGE_REG
            int
            depends on BSP_PMIC_SET_CHARGER
            default 2 if BSP_PMIC_CHARGE_VOLTAGE_4V10
            default 3 if BSP_PMIC_CHARGE_VOLTAGE_4V20
            default 4 if BSP_PMIC_CHARGE_VOLTAGE_4V35
            default 5 if BSP_PMIC_CHARGE_VOLTAGE_4V40
    endmenu

    menu "SPIFFS"
        config BSP_SPIFFS_FORMAT_ON_MOUNT_FAIL
            bool "Format SPIFFS if mounting fails"
            default n

        config BSP_SPIFFS_MOUNT_POINT
            string "SPIFFS mount point"
            default "/spiffs"

        config BSP_SPIFFS_PARTITION_LABEL
            string "Partition label of SPIFFS"
            default "storage"

        config BSP_SPIFFS_MAX_FILES
            int "Max files supported for SPIFFS VFS"
            default 5
    endmenu

    menu "microSD card"
        config BSP_SD_MOUNT_POINT
            string "Mount point of the microSD card in the VFS"
            default "/sdcard"
    endmenu

    menu "Display"
        choice BSP_LCD_COLOR_FORMAT
            prompt "Select LCD color format"
            default BSP_LCD_COLOR_FORMAT_RGB565
            help
                Pixel format of the MIPI DPI frame buffer.
                It must match the LVGL color depth (RGB565 = 16 bit, RGB888 = 24 bit);
                a mismatch is rejected at compile time.

            config BSP_LCD_COLOR_FORMAT_RGB565
                bool "RGB565"
            config BSP_LCD_COLOR_FORMAT_RGB888
                bool "RGB888"
        endchoice

        config BSP_DISPLAY_BRIGHTNESS_LEDC_CH
            int "LEDC channel index"
            default 1
            range 0 7
            help
                LEDC channel is used to generate PWM signal that controls display brightness.
                Set LEDC index that should be used.

        config BSP_DISPLAY_LVGL_TASK_STACK_SIZE
            int "LVGL task stack size (bytes)"
            default 16384
            range 4096 131072
            help
                Stack size of the LVGL task created by bsp_display_start().
    endmenu

endmenu
```

## phone_s3/components/phone_app_settings/Kconfig
```kconfig
menu "Phone example"
    config PHONE_SD_CARD_MOUNT
        bool "Mount the microSD card at boot"
        default y
        help
            Mounts the card at the BSP mount point (/sdcard by default) in a background task.
            A card that cannot be mounted is reported as missing; it is never formatted.
            The slot has no card detect pin, so a card inserted later needs a restart.
endmenu
```

## phone_s3/components/phone_boot_splash/Kconfig
```kconfig
menu "Phone boot splash"

    choice PHONE_BOOT_SPLASH
        prompt "Boot splash"
        default PHONE_BOOT_SPLASH_SIMPLE
        help
            Shown from the display start until the phone is ready.

        config PHONE_BOOT_SPLASH_LOGO
            bool "Logo animation (splash.bin, about 900 KB of flash)"
        config PHONE_BOOT_SPLASH_SIMPLE
            bool "Simple: a hand-drawn line, then a greeting"
        config PHONE_BOOT_SPLASH_NONE
            bool "None"
    endchoice

endmenu
```
